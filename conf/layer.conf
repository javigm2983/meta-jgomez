## conf/layer.conf
```bitbake
# We have a conf and classes directory, add to BBPATH
BBPATH .= ":${LAYERDIR}"

# We have recipes-* directories, add to BBFILES
BBFILES += "${LAYERDIR}/recipes-*/*/*.bb \
            ${LAYERDIR}/recipes-*/*/*.bbappend"

BBFILE_COLLECTIONS += "meta-jgomez"
BBFILE_PATTERN_meta-jgomez = "^${LAYERDIR}/"
BBFILE_PRIORITY_meta-jgomez = "11"

LAYERDEPENDS_meta-jgomez = "core"
LAYERSERIES_COMPAT_meta-jgomez = "kirkstone"
```
